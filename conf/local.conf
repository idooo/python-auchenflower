## conf/local.conf
```bitbake
[global]
log.error_file: './logs/web.log'
log.screen: True
server.socket_host = "127.0.0.1"
server.socket_port = 8085
site.host = "127.0.0.1:8085"
server.thread_pool = 16
checker.on = True
request_queue_size = 500
tools.log_headers.on = True
request.show_tracebacks = True
request.show_mismatched_params = True

[misc]
git_revision = True

[database]
connector = 'mongodb.py'
address = 'localhost'
port = 27017
database = 'test'
user = 'user'
pass = 'password'

[sass]
enabled = False
src_dir = './templates/src'
output_dir = './templates/css'

[debug]
web_debug = True
model_debug = True

[/]
tools.staticdir.root = "/Users/ido/github/Auchenflower"
tools.encode.encoding = 'utf8'

[/css]
tools.staticdir.on = True
tools.staticdir.dir = "./templates/css/"

[/images]
tools.staticdir.on = True
tools.staticdir.dir = "./templates/images/"

[/js]
tools.staticdir.on = True
tools.staticdir.dir = "./templates/js/"
```
